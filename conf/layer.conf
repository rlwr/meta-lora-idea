## conf/layer.conf
```bitbake
BBPATH := "${LAYERDIR}:${BBPATH}"
BBFILES := "${BBFILES} ${LAYERDIR}/recipes-*/*/*.bb \
            ${LAYERDIR}/recipes-*/*/*.bbappend"

BBFILE_COLLECTIONS += "lora-idea"
BBFILE_PATTERN_lora-idea := "^${LAYERDIR}/"
BBFILE_PRIORITY_lora-idea = "20"

# We have a pre-populated downloads directory, add to PREMIRRORS
PREMIRRORS_append := "\
     git://.*/.* file://${LAYERDIR}/downloads/ \n \
     git://.*/.* git://${LAYERDIR}/git/BASENAME;protocol=file \n \
     svn://.*/.* file://${LAYERDIR}/downloads/ \n \
     ftp://.*/.* file://${LAYERDIR}/downloads/ \n \
     http://.*/.* file://${LAYERDIR}/downloads/ \n \
     https://.*/.* file://${LAYERDIR}/downloads/ \n"
```
